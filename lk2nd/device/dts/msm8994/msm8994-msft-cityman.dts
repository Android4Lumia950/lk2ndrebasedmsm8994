
// SPDX-License-Identifier: BSD-3-Clause

#include <skeleton64.dtsi>
#include <lk2nd.dtsi>

/ {
	model = "Microsoft Lumia 950 XL";
	qcom,msm-id = <QCOM_ID_MSM8994 00020001 0x0001001a 0>;
	qcom,board-id = <26 0>;
	qcom,pmic-id = <0x20009 0x2000a 0x0 0x0>;
};

&lk2nd {
	model = "Microsoft Lumia 950 XL";
	compatible = "microsoft,cityman";
};
